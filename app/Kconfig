## app/Kconfig
```kconfig
menuconfig LED_SUBSYSTEM
    bool "LED Subsystem"
    default y

if LED_SUBSYSTEM
    choice
        prompt "LED blink sleep time"
        default BLINK_SLEEP_1000MS

        config BLINK_SLEEP_250MS
            bool "250ms (very fast)"

        config BLINK_SLEEP_500MS
            bool "500ms (fast)"

        config BLINK_SLEEP_1000MS
            bool "1s (medium)"
        
        config BLINK_SLEEP_2000MS
            bool "2s (slow)"

    endchoice

    menuconfig ADVACNED_LED_SETTINGS
        bool "Advanced LED settings"
        default n

        if ADVACNED_LED_SETTINGS

            config LED_BRIGHTNESS
                int "LED Brightness (0-100)"
                range 0 100
                default 100

            config LED_FADE_DURATION
                int "LED Fade Duration (ms)"
                range 0 5000
                default 500
        endif
            
        menu "Expert Settings"
            visible if ADVACNED_LED_SETTINGS
            config LED_DEBUG_ENABLE
                bool "Enable LED debugging"
                default n

                config LED_CUSTOM_BLINK_PATTERN
                bool "Custom blink pattern"
                default n
        endmenu
endif

config BLINK_SLEEP_TIME_MS
    int
    default 250 if BLINK_SLEEP_250MS
    default 500 if BLINK_SLEEP_500MS
    default 1000 if BLINK_SLEEP_1000MS
    default 2000 if BLINK_SLEEP_2000MS

source "Kconfig.zephyr"
```

## l5-task/boards/my_board/my_board_defconfig
```kconfig
# enable GPIO
CONFIG_GPIO=y

# enable uart driver
CONFIG_SERIAL=y
CONFIG_UART_INTERRUPT_DRIVEN=y

# console
CONFIG_CONSOLE=y
CONFIG_UART_CONSOLE=y
```

## l5-task/boards/our_board/Kconfig.our_board
```kconfig
# Copyright (c) 2023 Tisilicon
# SPDX-License-Identifier: Apache-2.0

config BOARD_OUR_BOARD
	select SOC_STM32L475XX
```

## l6-task/boards/my_board/board.yml
```yaml
board:
  name: my_board
  full_name: My Board stm32L475
  vendor: bhupendra
  socs:
    - name: stm32l475xx
```

## l6-task/boards/our_board/board.yml
```yaml
board:
  name: our_board
  full_name: Our Board stm32L475
  vendor: bhupendra
  socs:
    - name: stm32l475xx
```
