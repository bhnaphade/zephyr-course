## CMakeLists.txt
```
cmake_minimum_required(VERSION 3.20.0)

list(APPEND DTS_ROOT ${CMAKE_CURRENT_SOURCE_DIR})
find_package(Zephyr REQUIRED)
project(my_zephyr_app)

target_sources(app PRIVATE src/main.cpp)

add_subdirectory(drivers/my_led_sensor)
```

## Kconfig
```
menu "Zephyr Course Assignments"
    comment "l4-task1: Heartbeat LED via Kconfig + Overlay"

    config APP_HEARTBEAT_PERIOD_MS
        int "Heartbeat period in (100-2000 ms)"
        range 100 2000
        default 500
        
    comment "l3-task1: LED configuration"

    menuconfig LED_SUBSYSTEM
        bool "LED Subsystem"
        default y

    if LED_SUBSYSTEM
        choice
            prompt "LED blink sleep time"
            default BLINK_SLEEP_1000MS

            config BLINK_SLEEP_250MS
                bool "250ms (very fast)"

            config BLINK_SLEEP_500MS
                bool "500ms (fast)"

            config BLINK_SLEEP_1000MS
                bool "1s (medium)"
            
            config BLINK_SLEEP_2000MS
                bool "2s (slow)"

        endchoice

        menuconfig ADVACNED_LED_SETTINGS
            bool "Advanced LED settings"
            default n

            if ADVACNED_LED_SETTINGS

                config LED_BRIGHTNESS
                    int "LED Brightness (0-100)"
                    range 0 100
                    default 100

                config LED_FADE_DURATION
                    int "LED Fade Duration (ms)"
                    range 0 5000
                    default 500
            endif
                
            menu "Expert Settings"
                visible if ADVACNED_LED_SETTINGS
                config LED_DEBUG_ENABLE
                    bool "Enable LED debugging"
                    default n

                    config LED_CUSTOM_BLINK_PATTERN
                    bool "Custom blink pattern"
                    default n
            endmenu
    endif

    config BLINK_SLEEP_TIME_MS
        int
        default 250 if BLINK_SLEEP_250MS
        default 500 if BLINK_SLEEP_500MS
        default 1000 if BLINK_SLEEP_1000MS
        default 2000 if BLINK_SLEEP_2000MS
endmenu

source "Kconfig.zephyr"
rsource "drivers/my_led_sensor/Kconfig"
```

## prj.conf
```kconfig
CONFIG_GPIO=y
CONFIG_LOG=y
CONFIG_SHELL=y
CONFIG_MY_LED_SENSOR=y


#CONFIG_BLINK_SLEEP_250MS=y
#CONFIG_BLINK_SLEEP_TIME_MS=1000
#CONFIG_BLINK_SLEEP_TIME_MS=y    Not allowed as its an integer
```

## dts/bindings/my-led,sensor.yaml
```yaml
description: My LED Sensor
compatible: "my-led,sensor"
include: base.yaml
```

## src/main.cpp
```c
#include <zephyr/drivers/gpio.h>
#include <zephyr/drivers/sensor.h>
#include <zephyr/kernel.h>
#include <zephyr/logging/log.h>

LOG_MODULE_REGISTER(main, LOG_LEVEL_INF);

int main(void)
{
    LOG_INF("System Shell ready!");

    while (1) {
         k_msleep(CONFIG_APP_HEARTBEAT_PERIOD_MS);
    }
    return 0;
}
```
